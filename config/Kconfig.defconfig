## config/Kconfig.defconfig
```kconfig
# Copyright (c) 2022 The ZMK Contributors
# SPDX-License-Identifier: MIT

if SHIELD_HUMMINGBIRD

config ZMK_KEYBOARD_NAME
    default "Metasepia"
config USB_DEVICE_MANUFACTURER
    default "Zakwaykway"

endif
```

## config/Kconfig.shield
```kconfig
# Copyright (c) 2022 The ZMK Contributors
# SPDX-License-Identifier: MIT

config SHIELD_HUMMINGBIRD
   def_bool $(shields_list_contains,hummingbird)

config SHIELD_METASEPIA
   def_bool $(shields_list_contains,metasepia)
```

## config/west.yml
```yaml
manifest:
  remotes:
    - name: zmkfirmware
      url-base: https://github.com/zmkfirmware
    - name: urob
      url-base: https://github.com/urob
    - name: zakwaykway
      url-base: https://github.com/zakwaykway
  projects:
    - name: zmk
      remote: zmkfirmware
      revision: main
      import: app/west.yml
    - name: zmk-helpers
      remote: urob
      revision: main
    - name: zmk-keyboard-metasepia
      remote: zakwaykway
      revision: main
  self:
    path: config
```
